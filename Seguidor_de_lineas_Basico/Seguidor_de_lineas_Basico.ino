// DavidCa-Ops
// SEGUIDOR DE LINEAS PROGRAMABLE
int SENSORI = A0; // PIN SENSOR IZQUIERDO
int SENSORD = A1; // PIN SENSOR DERECHO
int MD = 7;       //MOTOR DERECHO EN SALIDA DIGITAL  PIN 7>>>>2 DEL IC L293D
int MDD = 6;      // MOTOR DERECHO EN SALIDA DIGITAL PIN 6>>>>7 DEL IC L293D
int MI = 9;       // MOTOR IZQUIERDO EN SALIDA DIGITAL PIN 9>>>>10 DEL IC L293D
int MII = 8;      // MOTOR IZQUIERDO EN SALIDA DIGITAL PIN 8>>>>15 DEL IC L293D
int LEDD = 4;     // LED INDICADOR SENSOR DERECHO
int LEDI = 5;     // LED INDICADOR SENSOR IZQUIERDO
int TipoLinea = 400; // INDICADOR DEL TIPO DE LINEA A SEGUIR, 400 = LINEA NEGRA, 300 LINEA BLANCA
/// NOTA PUEDE AJUSTAR EL VALOR DE TipoLinea PARA MAYOR SENSIBILIDAD
int VALORD = 0;   // TOMA VALOR DEL SENSOR DERECHO 
int VALORI = 0;   // TOMA VALOR DEL SENSOR IZQUIERDO

void setup(){
   Serial.begin(9600);    // DECLARACIÓN DE SALIDA POR INSPECTOR
  pinMode(MD,OUTPUT);     //DECLARACIÓN DE PUERTO DE SALIDA DIGITAL
  pinMode(MDD,OUTPUT);    //DECLARACIÓN DE PUERTO DE SALIDA DIGITAL
  pinMode(MI,OUTPUT);     //DECLARACIÓN DE PUERTO DE SALIDA DIGITAL
  pinMode(MII,OUTPUT);    //DECLARACIÓN DE PUERTO DE SALIDA DIGITAL
  pinMode(LEDI,OUTPUT);   //DECLARACIÓN DE PUERTO DE SALIDA DIGITAL
  pinMode(LEDD,OUTPUT);   //DECLARACIÓN DE PUERTO DE SALIDA DIGITAL
  pinMode(SENSORI,INPUT); //DECLARACIÓN DE PUERTO DE ENTRADA ANALOGICA
  pinMode(SENSORD,INPUT); //DECLARACIÓN DE PUERTO DE SALIDA ANALOGICA
}

void loop(){
  VALORI = analogRead(SENSORI);   // SE LEE EL VALOR DE A0, SENSOR IZQUIERDO
  VALORD = analogRead(SENSORD);   // SE LEE EL VALOR DE A1, SENSOR DERECHO


  if(VALORI >= TipoLinea && VALORD >= TipoLinea){   // SI SENSORD ES MAYOR O IGUAL A LA VARIABLE TipoLinea 
                                                    // SIGNIFICA QUE LA LINEA SE DETECTO CORRECTAMENTE Y COMIENZA LA MARCHA
      ADELANTE();
      digitalWrite(LEDI,HIGH);
      digitalWrite(LEDD,HIGH);
  }

  if(VALORI < TipoLinea){    //SI SENSORI ES MENOR A TipoLinea GIRO DERECHA
     DERECHA();
    
    digitalWrite(LEDI,HIGH);
    digitalWrite(LEDD,LOW);
  }

  if(VALORD < TipoLinea){    //SI SENSORI ES MENOR A TipoLinea GIRO IZQUIERDA
     IZQUIERDA(); 
   
    digitalWrite(LEDI,LOW);
    digitalWrite(LEDD,HIGH);
  }
}

  void IZQUIERDA(){ // GIRA MOTOR IZQUIERDA HACIA ATRAS
    digitalWrite(MI,LOW);
    digitalWrite(MII,LOW);
    digitalWrite(MD,LOW);
    digitalWrite(MDD,HIGH); //GIRA MOTOR DERECHO HACIA ADELANTE
  }
  void DERECHA(){   //GIRA MOTOR DERECHO HACIA ATRAS
    digitalWrite(MI,HIGH); // GIRA MOTOR IZQUIERDO HACIA ADELANTE
    digitalWrite(MII,LOW);
    digitalWrite(MD,LOW);
    digitalWrite(MDD,LOW);
  }
  void ADELANTE(){
    digitalWrite(MI,HIGH);  // GIRA MOTOR IZQUIERDO HACIA ADELANTE
    digitalWrite(MII,LOW);
    digitalWrite(MD,LOW);
    digitalWrite(MDD,HIGH); //GIRA MOTOR DERECHO HACIA ADELANTE
  }


  
